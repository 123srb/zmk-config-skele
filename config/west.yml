## config/west.yml
```yaml
manifest:
  defaults:
    revision: v0.3
  remotes:
    - name: zmkfirmware
      url-base: https://github.com/zmkfirmware
    # Additional modules containing boards/shields/custom code can be listed here as well
    # See https://docs.zephyrproject.org/3.2.0/develop/west/manifest.html#projects
  projects:
    - name: zmk
      remote: zmkfirmware
      import: app/west.yml
    - name: zmk-keyboard-skeletyl-handwired
      url: https://github.com/123srb/zmk-keyboard-skeletyl-handwired
      revision: main
      path: modules/zmk-keyboard-skeletyl-handwired
  self:
    path: config
```
